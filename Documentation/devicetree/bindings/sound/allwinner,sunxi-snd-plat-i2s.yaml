## Documentation/devicetree/bindings/sound/allwinner,sunxi-snd-plat-i2s.yaml
```yaml
# SPDX-License-Identifier: (GPL-2.0-only OR BSD-2-Clause)
%YAML 1.2
---
$id: http://devicetree.org/schemas/sound/allwinner,sunxi-snd-plat-i2s.yaml#
$schema: http://devicetree.org/meta-schemas/core.yaml#

title: Allwinner sunxi I2S/TDM controller (sun50iw15 and related)

maintainers:
  - H726 open kernel effort <kernel@h726.invalid>

description: |
  The Allwinner sunxi I2S/TDM controller.  The channel registers were
  recovered from the vendor module (snd_soc_sunxi_i2s), not from a datasheet:

    0x30        channel configuration: TX slots - 1 in [3:0],
                RX slots - 1 in [7:4]
    0x34+8p     TX channel select for hub pin p: slot offset [21:20],
                slots - 1 [19:16], channel enable mask [15:0]
    0x48+8p     TX channel map, low slots: eight 4-bit channel entries
    0x44+8p     TX channel map, high slots (8..15)
    0x64        RX channel select: slot offset [21:20], slots - 1 [19:16]
    0x74        RX channel map, slots 0..3, one byte each
    0x70        RX channel map, slots 4..7
    0x6c        RX channel map, slots 8..11
    0x68        RX channel map, slots 12..15

  Each RX map byte holds (rxfifo-pinmap << 4) | rxfifo-chmap for that slot.
  The driver programs the maps on every hw_params and leaves the identity
  mapping (slot i plays channel i) when the properties below are absent,
  which is what the vendor firmware does.

properties:
  compatible:
    enum:
      - allwinner,sunxi-snd-plat-i2s
      - allwinner,sun8iw11-i2s
      - allwinner,sun8iw17-i2s

  reg:
    maxItems: 1

  clocks:
    items:
      - description: Bus clock
      - description: Audio PLL
      - description: Peripheral PLL
      - description: Module clock

  clock-names:
    items:
      - const: clk_bus_i2s
      - const: clk_pll_audio_4x
      - const: clk_pll_peri0_200m
      - const: clk_i2s

  resets:
    maxItems: 1

  dmas:
    maxItems: 2
    description: Playback and capture DMA channels.

  dma-names:
    items:
      - const: tx
      - const: rx

  '#sound-dai-cells':
    const: 0

  playback-cma:
    $ref: /schemas/types.yaml#/definitions/uint32
    default: 1024
    description: Playback CMA buffer size in KiB (vendor clamps 0x40..0x400).

  capture-cma:
    $ref: /schemas/types.yaml#/definitions/uint32
    default: 1024
    description: Capture CMA buffer size in KiB (vendor clamps 0x40..0x400).

  tx-fifo-size:
    $ref: /schemas/types.yaml#/definitions/uint32
    default: 128
    description: Playback FIFO depth in bytes.

  rx-fifo-size:
    $ref: /schemas/types.yaml#/definitions/uint32
    default: 128
    description: Capture FIFO depth in bytes.

  tx-fifo-offset:
    $ref: /schemas/types.yaml#/definitions/uint32
    default: 0x20
    description: |
      Playback FIFO offset from the reg base.  Recovered from the vendor
      probe, which stores base + 0x20 in the playback DMA address.

  rx-fifo-offset:
    $ref: /schemas/types.yaml#/definitions/uint32
    default: 0x10
    description: |
      Capture FIFO offset from the reg base.  Recovered from the vendor
      probe, which stores base + 0x10 in the capture DMA address.

  tdm-num:
    $ref: /schemas/types.yaml#/definitions/uint32
    maximum: 16
    description: TDM slot count, 0 for plain I2S.

  mclk-fs:
    $ref: /schemas/types.yaml#/definitions/uint32
    default: 256
    description: Master clock to sample rate ratio used when no sysclk is set.

  tx-hub-en:
    type: boolean
    description: |
      Enable the TX hub, where one stream feeds several output pins.  Without
      it only the channel count register is programmed.

  rx-sync-en:
    type: boolean
    description: Enable the RX synchronisation domain shared with other DAIs.

  tx-pin:
    $ref: /schemas/types.yaml#/definitions/uint32-array
    maxItems: 4
    description: |
      Hub pins that carry playback, one entry per pin, values 0..3.  The
      vendor enables exactly the listed slots.  When the property is absent
      the driver falls back to pin 0, matching the vendor device trees.

  rxfifo-chmap:
    $ref: /schemas/types.yaml#/definitions/uint32-array
    minItems: 1
    maxItems: 16
    description: |
      Capture channel map, one entry per slot: entry i is the channel that
      feeds slot i.  Entries must be below 16; larger values are replaced by
      0.  Defaults to the identity map.

  rxfifo-pinmap:
    $ref: /schemas/types.yaml#/definitions/uint32-array
    minItems: 1
    maxItems: 16
    description: |
      Per-slot pin half of the capture map, packed into the high nibble of
      each RX map byte.  Defaults to zero.

patternProperties:
  "^tx-pin[0-3]-chmap$":
    $ref: /schemas/types.yaml#/definitions/uint32-array
    minItems: 1
    maxItems: 16
    description: |
      Playback channel map for one hub pin, one entry per slot: entry i is
      the channel that feeds slot i of that pin.  Entries must be below 16;
      larger values are replaced by 0.  Defaults to the identity map.

required:
  - compatible
  - reg
  - clocks
  - clock-names
  - dmas
  - dma-names
  - '#sound-dai-cells'

additionalProperties: false

examples:
  - |
    i2s@2033000 {
        #sound-dai-cells = <0>;
        compatible = "allwinner,sunxi-snd-plat-i2s";
        reg = <0x0 0x02033000 0x0 0x7c>;
        resets = <&ccu 30>;
        clocks = <&ccu 105>, <&ccu 35>, <&ccu 7>, <&ccu 104>;
        clock-names = "clk_bus_i2s", "clk_pll_audio_4x",
                      "clk_pll_peri0_200m", "clk_i2s";
        dmas = <&dma 3>, <&dma 3>;
        dma-names = "tx", "rx";
        playback-cma = <128>;
        capture-cma = <128>;
        tx-fifo-size = <128>;
        rx-fifo-size = <128>;
        tdm-num = <0>;
        tx-pin = <0>;
        tx-hub-en;
        rx-sync-en;
    };

  - |
    /* Four hub pins with an explicit, reversed slot map on pin 0. */
    i2s@2033000 {
        #sound-dai-cells = <0>;
        compatible = "allwinner,sunxi-snd-plat-i2s";
        reg = <0x0 0x02033000 0x0 0x7c>;
        clocks = <&ccu 105>, <&ccu 35>, <&ccu 7>, <&ccu 104>;
        clock-names = "clk_bus_i2s", "clk_pll_audio_4x",
                      "clk_pll_peri0_200m", "clk_i2s";
        dmas = <&dma 3>, <&dma 3>;
        dma-names = "tx", "rx";
        tx-pin = <0>, <1>, <2>, <3>;
        tx-pin0-chmap = <1 0 3 2 5 4 7 6 9 8 11 10 13 12 15 14>;
        rxfifo-chmap = <0 1 2 3 4 5 6 7 8 9 10 11 12 13 14 15>;
        rxfifo-pinmap = <0 0 0 0 1 1 1 1 2 2 2 2 3 3 3 3>;
        tx-hub-en;
    };

...
```

## drivers/media/platform/sunxi/cedar/Kconfig
```kconfig
# SPDX-License-Identifier: GPL-2.0-only
config SUNXI_CEDAR_VE
	tristate "Allwinner H726 CEDAR video engine interface"
	depends on OF && PM
	help
	  Userspace interface for the H726 CEDAR video engine (/dev/cedar_dev):
	  register mapping, clock and reset control and the vendor ioctl set.
```

## drivers/misc/decd/Kconfig
```kconfig
# SPDX-License-Identifier: GPL-2.0-only
config SUNXI_DECD
	tristate "Allwinner H726 /dev/decd decoder ABI"
	depends on SYNC_FILE
	select DMABUF
	help
	  Userspace contract for the H726 hardware composer's decoder display
	  device (/dev/decd).  The vendor ships no H726 driver and no register
	  interface survives, so this implements the five proven ioctls with
	  defined behaviour rather than claiming hardware decode.
```

## drivers/phy/allwinner/Kconfig
```kconfig
# SPDX-License-Identifier: GPL-2.0-only
#
# Phy drivers for Allwinner platforms
#
config PHY_SUN4I_USB
	tristate "Allwinner sunxi SoC USB PHY driver"
	depends on ARCH_SUNXI || COMPILE_TEST
	depends on HAS_IOMEM
	depends on RESET_CONTROLLER
	depends on EXTCON
	depends on POWER_SUPPLY
	depends on USB_SUPPORT
	select GENERIC_PHY
	select USB_COMMON
	help
	  Enable this to support the transceiver that is part of Allwinner
	  sunxi SoCs.

	  This driver controls the entire USB PHY block, both the USB OTG
	  parts, as well as the 2 regular USB 2 host PHYs.

config PHY_SUN6I_MIPI_DPHY
	tristate "Allwinner A31 MIPI D-PHY Support"
	depends on ARCH_SUNXI || COMPILE_TEST
	depends on HAS_IOMEM && COMMON_CLK
	depends on RESET_CONTROLLER
	select GENERIC_PHY
	select GENERIC_PHY_MIPI_DPHY
	select REGMAP_MMIO
	help
	  Choose this option if you have an Allwinner SoC with
	  MIPI-DSI support. If M is selected, the module will be
	  called sun6i_mipi_dphy.

config PHY_SUN9I_USB
	tristate "Allwinner sun9i SoC USB PHY driver"
	depends on ARCH_SUNXI || COMPILE_TEST
	depends on HAS_IOMEM
	depends on RESET_CONTROLLER
	depends on USB_SUPPORT
	select USB_COMMON
	select GENERIC_PHY
	help
	  Enable this to support the transceiver that is part of Allwinner
	  sun9i SoCs.

	  This driver controls each individual USB 2 host PHY.

config PHY_SUN50IW15_USB
	tristate "Allwinner sun50iw15 SoC USB PHY driver"
	depends on ARCH_SUNXI || COMPILE_TEST
	depends on HAS_IOMEM && OF
	select GENERIC_PHY
	help
	  Enable this to support the shared USB PHY block of the Allwinner
	  sun50iw15 (H726) SoC used in the HY300 projector.  It programs the
	  PHY tuning word, routes the OTG PHY between the device controller and
	  the HCI, and handles the per-port passby and SIDDQ bits.

config PHY_SUN50I_USB3
	tristate "Allwinner H6 SoC USB3 PHY driver"
	depends on ARCH_SUNXI || COMPILE_TEST
	depends on HAS_IOMEM && OF
	depends on RESET_CONTROLLER
	select GENERIC_PHY
	help
	  Enable this to support the USB3.0-capable transceiver that is
	  part of Allwinner H6 SoC.

	  This driver controls each individual USB 2+3 host PHY combo.
```

## drivers/soc/sunxi/Kconfig
```kconfig
# SPDX-License-Identifier: GPL-2.0-only
#
# Allwinner sunXi SoC drivers
#

config SUNXI_MBUS
	bool
	default ARCH_SUNXI
	help
	  Say y to enable the fixups needed to support the Allwinner
	  MBUS DMA quirks.

config SUNXI_SRAM
	bool
	default ARCH_SUNXI
	select REGMAP_MMIO
	help
	  Say y here to enable the SRAM controller support. This
	  device is responsible on mapping the SRAM in the sunXi SoCs
	  whether to the CPU/DMA, or to the devices.

config SUN50IW15_ADDR
	bool "Allwinner sun50iw15 network address manager"
	depends on ARCH_SUNXI || COMPILE_TEST
	help
	  Replacement for the vendor sunxi_addr module.  It owns one MAC
	  address per interface (wifi, bt, eth), derives them from the SID
	  chipid when the device tree asks for that, and exposes them through
	  the sunxi-addr-mgt class.

config SUN50IW15_BOOTEVENT
	bool "Allwinner boot time log (/proc/bootevent)"
	depends on PROC_FS && TRACEPOINTS
	help
	  Replacement for the vendor bootevent module.  Keeps a 960 entry ring of
	  boot milestones in /proc/bootevent, fed from the initcall tracepoints,
	  and exports sunxi_bootevent_log() for other drivers.

config SUN50IW15_RFKILL
	bool "Allwinner sun50iw15 wlan/bt power and rfkill control"
	depends on ARCH_SUNXI || COMPILE_TEST
	select RFKILL
	help
	  Replacement for the vendor sunxi_rfkill module.  Drives the WLAN and
	  Bluetooth regulators and enable lines described by the sunxi-rfkill
	  device tree node, exposes the sunxi-wlan misc device with the rf-ctrl
	  power_state/scan_device attributes, and registers an rfkill device for
	  Bluetooth.


config SUN50IW15_DRM_HEAP
	bool "Allwinner sun50iw15 DRM heap (/dev/sunxi_drm_heap)"
	depends on ARCH_SUNXI || COMPILE_TEST
	select DMA_SHARED_BUFFER
	select GENERIC_ALLOCATOR
	help
	  Replacement for the vendor's built-in drm_heap driver: a gen_pool
	  carveout exported as a dma-buf behind /dev/sunxi_drm_heap, used by the
	  composer's secure ladder (ioctl 0xC0184800, 24-byte request with the
	  size at +0 and the dma-buf descriptor returned at +8).

	  The vendor obtains the carveout from OP-TEE; this driver takes it from
	  an "allwinner,sunxi-drm-heap" node with a reg property, or from the
	  sunxi_drm_heap.heap_base / sunxi_drm_heap.heap_size parameters.  With
	  neither, the device still appears and allocation fails with ENOSPC.

config SUN50IW15_HIDTVREG
	bool "Allwinner sun50iw15 HiDTV register access device"
	depends on ARCH_SUNXI || COMPILE_TEST
	help
	  Replacement for the vendor hidtvreg_dev module.  Provides
	  /dev/hidtvreg: the TV HAL reads display registers through ioctl
	  0x1700, maps register windows with mmap, and flushes buffers with
	  ioctl 0x5f04.  The register window is unrestricted, exactly as in
	  the vendor driver, because no other driver owns the TV blocks.

config SUN50IW15_IR
	bool "Allwinner sun50iw15 IR receiver"
	depends on ARCH_SUNXI || COMPILE_TEST
	depends on RC_CORE
	help
	  Replacement for the vendor sunxi-ir-rx module: rc-core driver for the
	  allwinner,irrx receiver block.

config SUN50IW15_MOTOR
	bool "Allwinner sun50iw15 focus motor and limiter"
	depends on OF && GPIOLIB
	help
	  Focus motor (stepper phase GPIOs plus end-stop switch) for the
	  H726/HY300 projector.  Provides /dev/motor_limiter, motor_ctrl and
	  motor_limit sysfs attributes, a contrast (Sobel) autofocus search with
	  coarse/fine sweeps and parabolic refinement, and exports
	  sun50iw15_motor_vafocus() so the accelerometer can start an autofocus
	  run on shake.  Sharpness comes from a registered frame source or, when
	  none is present, from userspace through the af_metric attribute.
	  A measured subject distance (for example from a time-of-flight range
	  sensor) can seed the search through af_seed or
	  sun50iw15_motor_seed_distance(), which narrows the sweep to the window
	  around the expected focus position.



config SUN50IW15_PCK_PD
	bool "Allwinner sun50iw15 pck-600 power domains"
	depends on ARCH_SUNXI || COMPILE_TEST
	help
	  Registers the GPU and VE power domains of the pck-600 power
	  controller so devices with a power-domains phandle can attach, and
	  gates them through the PCK-600 power policy unit registers recovered
	  from the vendor driver (per-domain 4 KiB blocks, PWPR/PWSR power mode
	  field, 10 ms transition poll) so idle domains can be switched off.
	  Each domain's PWPR/PWSR state is logged at probe and exposed in
	  debugfs under /sys/kernel/debug/sun50iw15-pck-pd/.

config SUN50IW15_PCK_PD_TOLERATE_TIMEOUT
	bool "Tolerate pck-600 power transition timeouts (bring-up only)"
	depends on SUN50IW15_PCK_PD
	default y
	help
	  Bring-up escape hatch for the pck-600 GPU/VE power domains.

	  The power transition delays programmed by the driver are inherited
	  from the A523 block because this SoC's vendor values could not be
	  recovered.  With this option on, a transition that does not report
	  the requested state within 10 ms is logged and treated as success:
	  a domain that fails to power off is marked stuck-on and not polled
	  again, and a failed power-on no longer fails the consumer's runtime
	  resume.

	  Set this to n for production once the delays have been verified on
	  hardware; that restores strict gating, where transition failures are
	  logged and returned to genpd.

config SUNXI_TVTOP
	tristate "Allwinner sunxi TV top module (tvfe/tvcap)"
	depends on OF && EXTCON
	help
	  TV front end and capture top block: clock/reset bring-up,
	  CVBS detection and the exported client interface used by
	  the display stack.

config SUNXI_TVTOP_ADC
	tristate "Allwinner sunxi TV top ADC interface"
	depends on SUNXI_TVTOP
	help
	  Character device exposing the TV front end ADC registers.

config SUNXI_KSC
	tristate "Allwinner H726 keystone correction (KSC)"
	depends on OF
	help
	  Keystone correction device (/dev/ksc) used by the projector
	  geometry controls.
```

## drivers/usb/sunxi/Kconfig
```kconfig
# SPDX-License-Identifier: GPL-2.0-only
#
# Allwinner sun50iw15 (H726 / HY300) USB support
#

menu "Allwinner sun50iw15 (H726) USB support"

config USB_SUN50IW15_USBC
	tristate "Allwinner sun50iw15 USB OTG manager"
	depends on OF
	depends on EXTCON
	help
	  Say Y or M to add the USB OTG manager of the Allwinner sun50iw15
	  (H726) SoC, as used by the HY300 projector.  It owns the usbc0
	  "port type" configuration, the usbc / detvbus regulators, the
	  extcon provider and (in role-switch mode) the USB role switch.

endmenu
```
